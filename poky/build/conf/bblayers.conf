## poky/build/conf/bblayers.conf
```bitbake
# POKY_BBLAYERS_CONF_VERSION is increased each time build/conf/bblayers.conf
# changes incompatibly
POKY_BBLAYERS_CONF_VERSION = "2"

BBPATH = "${TOPDIR}"
BBFILES ?= ""

BBLAYERS ?= " \
  /home/krlos/Project_Rasberri_Pi/yocto/poky/meta \
  /home/krlos/Project_Rasberri_Pi/yocto/poky/meta-poky \
  /home/krlos/Project_Rasberri_Pi/yocto/poky/meta-yocto-bsp \
  /home/krlos/Project_Rasberri_Pi/yocto/poky/meta-raspberrypi \
  /home/krlos/Project_Rasberri_Pi/yocto/poky/meta-rpi-krlos \
  /home/krlos/Project_Rasberri_Pi/yocto/poky/meta-openembedded/meta-oe \
  "
```

## poky/meta-rpi-krlos/conf/layer.conf
```bitbake
# We have a conf and classes directory, add to BBPATH
BBPATH .= ":${LAYERDIR}"

# We have recipes-* directories, add to BBFILES
BBFILES += "${LAYERDIR}/recipes-*/*/*.bb \
            ${LAYERDIR}/recipes-*/*/*.bbappend"

BBFILE_COLLECTIONS += "meta-rpi-krlos"
BBFILE_PATTERN_meta-rpi-krlos = "^${LAYERDIR}/"
BBFILE_PRIORITY_meta-rpi-krlos = "6"

LAYERDEPENDS_meta-rpi-krlos = "core"
LAYERSERIES_COMPAT_meta-rpi-krlos = "kirkstone"
```
